/** Arduino-Esp32-CAM                                      *** InStream.ino ***
 * 
 *                    Сфотографировать камерой Esp32-Cam и записать изображение
 *                                  в обычном или однобитном режиме на SD-карту
 * 
 * v1.0.1, 14.03.2025                                 Автор:      Труфанов В.Е.
 * Copyright © 2025 tve                               Дата создания: 12.03.2025
 * 
 * В обычном режиме запись на SD-карту ESP32-CAM происходим через четыре пина
 * и сопровождается вспышкой светодиода на 4 контакте. В однобитном режиме 
 * запись происходит медленнее, но светодиод не загорается.
 * 
**/

#include "OV2640.h"
#include "SD_MMC.h"            
#include <EEPROM.h>        

// Определяем число байт для хранения в постоянной памяти
#define EEPROM_SIZE 1
// Определяем пин вспышки
#define BUILTIN_LED 4
// Инициализируем переменную, обеспечивающую генерацию названий фотографий:
// picture1.jpg, picture2.jpg ...
int pictureNumber = 0;
// Инициируем объект для фотографирования
OV2640 cam;
// Определяем режим записи на SD
#define SD_MODE_NORMAL 4  // обычный по 4 контактам со вспышкой
#define SD_MODE_1BIT   1  // однобитовый, медленный, без вспышки

#define SD_MODE SD_MODE_1BIT  

// ****************************************************************************
// *          Выполнить настройки один раз при нажатии кнопки reset           *
// *                      или при включении питания платы                     *
// ****************************************************************************
void setup() 
{
  Serial.begin (115200);
  while (!Serial) {;}
  Serial.println("Подключен последовательный порт");
  // Инициируем постоянную память заданного размера
  EEPROM.begin(EEPROM_SIZE);
  // Назначаем номер первой сохраняемой фотографии
  EEPROM.write(0, 254);
  EEPROM.commit();
  Serial.println("Инициирована постоянная память\n");

  Serial.println("Подключаем SD-карту");
  // Настраиваем обычный или однобитовый режим работы
  #if (SD_MODE==SD_MODE_NORMAL)
    if(!SD_MMC.begin())
  #else
    if (!SD_MMC.begin("/sdcard", true))
  #endif
  {
    Serial.println("SD-карта не смонтирована");
    return;
  }
  else Serial.println("SD карта смонтирована");
  // Гасим вспышку в однобитовом режиме
  #if (SD_MODE==SD_MODE_1BIT)
    pinMode(BUILTIN_LED, OUTPUT);
    digitalWrite(BUILTIN_LED, LOW);
  #endif 
  // Подключаем устройство
  uint8_t cardType = SD_MMC.cardType();
  if(cardType == CARD_NONE)
  {
    Serial.println("SD карта не подключена");
    return;
  }
  else Serial.println("SD карта подключена");
  
  // Инициируем камеру 
  cam.init(esp32cam_aithinker_config);
  // Определяем дополнительную задачу
  xTaskCreatePinnedToCore (
    instream,       // название функции, которая будет запускаться, как параллельная задача
    "instream",     // название задачи
    4096,           // размер стека в байтах. Задача будет использовать этот объем памяти, когда 
                    // ей потребуется сохранить временные переменные и результаты. Для задач с 
                    // большим объемом памяти потребуется больший размер стека.
    NULL,           // указатель на параметр, который будет передан новой задаче. 
                    // NULL, если параметр не передаётся.
    9,              // приоритет задачи
    NULL,           // дескриптор или указатель на задачу. Его можно использовать для вызова задачи.
                    // Если это не требуется, то NULL.
    1               // идентификатор ядра процессора, на котором требуется запустить задачу. 
                    // У ESP32 есть два ядра, обозначенные как 0 и 1.
  );
}
// ****************************************************************************
// *                Циклически выполнять фоновую пустую задачу                *
// ****************************************************************************
void loop() 
{
}
// ****************************************************************************
// *              Выполнять фотографирование в некоторых циклах               *
// * !!! Если задача завершится (не будет циклится),контроллер перезагрузится *
// ****************************************************************************
void instream (void* pvParameters) 
{
  while (1) 
  {
    cam.run();
    size_t SizeFR = cam.getSize();
    callphoto(cam.getfb(),SizeFR);
    vTaskDelay(1200/portTICK_PERIOD_MS);
  }
}
int nCikl=0;
void callphoto(uint8_t *payload, uint16_t len)
{
  nCikl++;
  Serial.print("Цикл: "); Serial.println(nCikl);

  if ((nCikl>1) && (nCikl<15))
  {
    pictureNumber = EEPROM.read(0) + 1;
    // Определяем имя своего файла фотографии в каталоге карты microSD
    String path = "/picture" + String(pictureNumber) +".jpg";
    // Сохраняем фотографию на карту microSD
    fs::FS & fs = SD_MMC; 
    Serial.printf("Название фото: %s\n", path.c_str());
    File file = fs.open(path.c_str(), FILE_WRITE);
    if(!file)
    {
      Serial.println("Ошибка открытия файла в режиме записи");
    } 
    else 
    {
      file.write(payload, len); 
      Serial.printf("Сохранено изображение: %s\n", path.c_str());
      // Cохраняем текущий номер снимка во флэш-памяти, 
      // чтобы отслеживать количество сделанных фотографий.
      EEPROM.write(0, pictureNumber);
      EEPROM.commit();
    }
    file.close();
  }
}

// *********************************************************** InStream.ino ***
